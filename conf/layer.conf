## conf/layer.conf
```bitbake
#
# Copyright (C) 2017 Wind River Systems, Inc.
#

# We have a conf and classes directory, add to BBPATH
BBPATH =. "${LAYERDIR}:"

# We have a packages directory, add to BBFILES
BBFILES += "${LAYERDIR}/recipes-*/*/*.bb \
        ${LAYERDIR}/recipes-*/*/*.bbappend"

BBFILE_COLLECTIONS += "meta-signing-key"
BBFILE_PATTERN_meta-signing-key = "^${LAYERDIR}/"
BBFILE_PRIORITY_meta-signing-key = "7"

# This should only be incremented on significant changes that will
# cause compatibility issues with other layers
LAYERVERSION_meta-signing-key = "1"

# Define the sample key store for feature/mok-secure-boot and feature/efi-secure-boot
SIGNING_MODEL ??= "sample"
SAMPLE_MOK_SB_KEYS_DIR = "${LAYERDIR}/files/mok_sb_keys"
SAMPLE_UEFI_SB_KEYS_DIR = "${LAYERDIR}/files/uefi_sb_keys"
SAMPLE_SYSTEM_TRUSTED_KEYS_DIR = "${LAYERDIR}/files/system_trusted_keys"
SAMPLE_IMA_KEYS_DIR = "${LAYERDIR}/files/ima_keys"
SAMPLE_RPM_KEYS_DIR = "${LAYERDIR}/files/rpm_keys"

# Microsoft certificates
MSFT_DB_CERT = "${LAYERDIR}/files/uefi_sb_keys/ms-DB.pem"
MSFT_KEK_CERT = "${LAYERDIR}/files/uefi_sb_keys/ms-KEK.pem"

# EV certificate
EV_CERT ??= "${LAYERDIR}/files/mok_sb_keys/wosign_ev_cert.pem"

# By default the sample keys are used
MOK_SB_KEYS_DIR ??= "${SAMPLE_MOK_SB_KEYS_DIR}"
UEFI_SB_KEYS_DIR ??= "${SAMPLE_UEFI_SB_KEYS_DIR}"
SYSTEM_TRUSTED_KEYS_DIR ??= "${SAMPLE_SYSTEM_TRUSTED_KEYS_DIR}"
IMA_KEYS_DIR ??= "${SAMPLE_IMA_KEYS_DIR}"
RPM_KEYS_DIR ??= "${SAMPLE_RPM_KEYS_DIR}"

# Define the identification of Wind River Linux Secure 
WR_SECURE_VENDOR_UUID = "1f7b9654-2107-4697-8f1c-0cbc38874588"

# User configurable identification of signature owner 
UEFI_SIG_OWNER_GUID ??= "${WR_SECURE_VENDOR_UUID}"

SAMPLE_RPM_KEYNAME = "Wind-River-Pulsar-8"
RPM_GPG_NAME ??= "${SAMPLE_RPM_KEYNAME}"

BB_HASHBASE_WHITELIST_append += " IMA_SIGNING_BLACKLIST IMA_KEYS_DIR \
                                  RPM_KEYS_DIR UEFI_SB_KEYS_DIR EV_CERT \
                                  MOK_SB_KEYS_DIR MSFT_DB_CERT MSFT_KEK_CERT"
```
